## 1040_307_01_jumped_2_opensbi/uboot64_defconfig
```kconfig
CONFIG_RISCV=y
CONFIG_SYS_MALLOC_LEN=0x00800000
CONFIG_SYS_MALLOC_F_LEN=0x10000
CONFIG_NR_DRAM_BANKS=1
CONFIG_HAS_CUSTOM_SYS_INIT_SP_ADDR=y
CONFIG_CUSTOM_SYS_INIT_SP_ADDR=0x80700000
CONFIG_DEFAULT_DEVICE_TREE="viettel/chipyardharnessViettelDualSSV2DDR2GBFPGAConfig"
CONFIG_SYS_BOOTM_LEN=0x04000000
CONFIG_SYS_LOAD_ADDR=0x90000000
CONFIG_TARGET_OPENHWGROUP_CVA6_GENESYSII=y
CONFIG_ARCH_RV64I=y
CONFIG_RISCV_SMODE=y
CONFIG_FIT=y
# CONFIG_LEGACY_IMAGE_FORMAT is not set
CONFIG_BOOTDELAY=5
CONFIG_OF_BOARD_SETUP=y
CONFIG_USE_BOOTCOMMAND=y
CONFIG_BOOTCOMMAND="mmc info; fatload mmc 0:2; bootm"
CONFIG_DISPLAY_CPUINFO=y
CONFIG_CMD_GPT=y
CONFIG_CMD_MMC=y
CONFIG_CMD_PART=y
CONFIG_CMD_DHCP=y
CONFIG_CMD_MDIO=y
CONFIG_CMD_PING=y
CONFIG_CMD_FAT=y
CONFIG_ENV_OVERWRITE=y
CONFIG_USE_BOOTFILE=y #todo
CONFIG_BOOTFILE="fitImage.itb" #todo
CONFIG_MMC=y
CONFIG_TEXT_BASE=0x80400000
# CONFIG_MMC_WRITE is not set
CONFIG_MMC_SPI=y
CONFIG_PHY_REALTEK=y
#CONFIG_LOWRISC_DIGILENT_100MHZ=y
CONFIG_SYS_NS16550=y
CONFIG_SPI=y
CONFIG_XILINX_SPI=y
# CONFIG_RANDOM_UUID is not set
CONFIG_SPL=y
CONFIG_SPL_TEXT_BASE=0x80000000
CONFIG_SPL_HAVE_INIT_STACK=y
CONFIG_SPL_STACK=0x80200000
CONFIG_SPL_BSS_START_ADDR=0x80040000
CONFIG_SPL_BSS_MAX_SIZE=0x10000
CONFIG_SPL_MAX_SIZE=0x40000
CONFIG_OF_UPSTREAM=y #for dts from dts/upstream
CONFIG_SPL_OPENSBI_LOAD_ADDR=0x80200000

CONFIG_SPL_LOAD_FIT=y
#CONFIG_SPL_FIT_SOURCE="uboot-fit-image.its" no need
CONFIG_SPL_LOAD_FIT_ADDRESS=0x82800000
CONFIG_SPL_SMP=n

# CONFIG_SPL_SEPARATE_BSS=y
CONFIG_SPL_HAS_CUSTOM_MALLOC_START=y
CONFIG_SPL_CUSTOM_SYS_MALLOC_ADDR=0x80700000
CONFIG_SPL_SYS_MALLOC=y
CONFIG_SPL_SHARES_INIT_SP_ADDR=n
#CONFIG_OF_BOARD=y todo

#TODO
#for testing
CONFIG_SPL_RAM_SUPPORT=y
CONFIG_SPL_RAM_DEVICE=y
CONFIG_SPL_ZERO_MEM_BEFORE_USE=n
CONFIG_SPL_SERIAL=n
CONFIG_SPL_DM_SERIAL=n
CONFIG_REQUIRE_SERIAL_CONSOLE=n
CONFIG_DEBUG_UART=n
```

## configs/genesys2/npu_fw_dummy/viettel_npu.its
```
/dts-v1/;

/ {
	description = "NPU firmware FIT";
	#address-cells = <1>;

	images {
		npu-fw {
			description = "Neuron Processor firmware";
			data = /incbin/("npu_fw.bin");
			type = "firmware";
			arch = "riscv";
			os = "invalid";
			compression = "none";

			load = <0x84000000>;
			entry = <0x84000000>;

			hash-1 {
				algo = "sha256";
			};
		};
	};

	configurations {
		default = "conf-1";

		conf-1 {
			description = "NPU firmware configuration";
			firmware = "npu-fw";
		};
	};
};
```

## configs/genesys2/uboot64_defconfig
```kconfig
CONFIG_RISCV=y
CONFIG_SYS_MALLOC_LEN=0x00800000
CONFIG_SYS_MALLOC_F_LEN=0x10000
CONFIG_NR_DRAM_BANKS=1
CONFIG_HAS_CUSTOM_SYS_INIT_SP_ADDR=y
CONFIG_CUSTOM_SYS_INIT_SP_ADDR=0x80500000
CONFIG_DEFAULT_DEVICE_TREE="viettel/chipyardharnessViettelDualSSV2DDR2GBFPGAConfig"
CONFIG_SYS_BOOTM_LEN=0x04000000
CONFIG_SYS_LOAD_ADDR=0x90000000
CONFIG_TARGET_VIETTEL_CVA6=y
CONFIG_ARCH_RV64I=y
CONFIG_RISCV_SMODE=y
CONFIG_FIT=y
# CONFIG_LEGACY_IMAGE_FORMAT is not set
CONFIG_BOOTDELAY=5
CONFIG_OF_BOARD_SETUP=y
CONFIG_USE_BOOTCOMMAND=y
CONFIG_BOOTCOMMAND="mmc info; fatload mmc 0:2; bootm"
CONFIG_DISPLAY_CPUINFO=y
CONFIG_CMD_GPT=y
CONFIG_CMD_MMC=y
CONFIG_CMD_PART=y
CONFIG_CMD_DHCP=y
CONFIG_CMD_MDIO=y
CONFIG_CMD_PING=y
CONFIG_CMD_FAT=y
CONFIG_ENV_OVERWRITE=y
# TODO: Review the default boot file.
CONFIG_USE_BOOTFILE=y
CONFIG_BOOTFILE="fitImage.itb"
CONFIG_MMC=y
CONFIG_TEXT_BASE=0x80200000
# CONFIG_MMC_WRITE is not set
CONFIG_MMC_SPI=y
CONFIG_PHY_REALTEK=y
#CONFIG_LOWRISC_DIGILENT_100MHZ=y
CONFIG_SYS_NS16550=y
CONFIG_SPI=y
CONFIG_XILINX_SPI=y
# CONFIG_RANDOM_UUID is not set
CONFIG_SPL=y
#CONFIG_SPL_TEXT_BASE=0x80000000
CONFIG_SPL_HAVE_INIT_STACK=y
#CONFIG_SPL_STACK=0x80200000
# Run FSBL on OCM
CONFIG_SPL_TEXT_BASE=0x08000000
CONFIG_SPL_STACK=0x08060000
CONFIG_SPL_BSS_START_ADDR=0x08040000
#
#CONFIG_SPL_BSS_START_ADDR=0x80040000
CONFIG_SPL_BSS_MAX_SIZE=0x10000
CONFIG_SPL_MAX_SIZE=0x40000
# Use the device tree from dts/upstream.
CONFIG_OF_UPSTREAM=y
CONFIG_SPL_OPENSBI_LOAD_ADDR=0x80000000

CONFIG_SPL_LOAD_FIT=y
#CONFIG_SPL_FIT_SOURCE="uboot-fit-image.its" no need
CONFIG_SPL_LOAD_FIT_ADDRESS=0x84000000

#LOAD QSPI
CONFIG_CVA6_SPL_QSPI_UBOOT_FIT_OFFSET=0x00300000
CONFIG_CVA6_SPL_QSPI_NPU_FIT_OFFSET=0x00500000
CONFIG_CVA6_SPL_QSPI_NPU_FIT_MAX_SIZE=0x00800000
#LOAD NPU FIRMWARE
CONFIG_CVA6_SPL_UBOOT_FIT_MAX_SIZE=0x00200000
CONFIG_CVA6_SPL_NPU_FIT_ADDR=0x00500000
CONFIG_CVA6_SPL_NPU_FIT_MAX_SIZE=0x00200000
CONFIG_CVA6_SPL_UBOOT_FIT_FILENAME="u-boot.itb"
CONFIG_CVA6_SPL_NPU_FIT_FILENAME="NPU_fw.itb"
#CONFIG_SPL_NPU_HANDOFF_BUILD=y
CONFIG_SPL_NPU_HANDOFF_BUILD=n
CONFIG_NPU_HANDOFF_BYJUMP_BUILD=y
CONFIG_CVA6_SPL_EMMC_DEVICE=0
CONFIG_SPL_SMP=n

# CONFIG_SPL_SEPARATE_BSS=y
CONFIG_SPL_HAS_CUSTOM_MALLOC_START=y
CONFIG_SPL_CUSTOM_SYS_MALLOC_ADDR=0x80500000
CONFIG_SPL_SYS_MALLOC=y
CONFIG_SPL_SHARES_INIT_SP_ADDR=n
#CONFIG_OF_BOARD=y todo
CONFIG_SPL_RISCV_FIXED_BOOT_HART=y
CONFIG_SPL_RISCV_BOOT_HART_ID=0

#TODO
#for testing
CONFIG_SPL_RAM_SUPPORT=y
CONFIG_SPL_RAM_DEVICE=y
CONFIG_SPL_ZERO_MEM_BEFORE_USE=n
##############
CONFIG_SPL_SERIAL=y
CONFIG_SPL_DM_SERIAL=y
CONFIG_REQUIRE_SERIAL_CONSOLE=n
CONFIG_DEBUG_UART=n
CONFIG_SIFIVE_SERIAL=y
CONFIG_SPL_OPENSBI_SCRATCH_OPTIONS=0x0

#for time
CONFIG_BOOTDELAY=0
```
